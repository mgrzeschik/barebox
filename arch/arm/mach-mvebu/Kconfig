## arch/arm/mach-mvebu/Kconfig
```kconfig
# SPDX-License-Identifier: GPL-2.0-only

if ARCH_MVEBU

config ARCH_ARMADA_370
	bool
	select CPU_V7
	select CLOCKSOURCE_MVEBU

config ARCH_ARMADA_XP
	bool
	select CPU_V7
	select CLOCKSOURCE_MVEBU

config ARCH_ARMADA_38X
	bool
	select CPU_V7
	select CLOCKSOURCE_MVEBU

config ARCH_DOVE
	bool
	select CPU_V7
	select CLOCKSOURCE_ORION

config ARCH_KIRKWOOD
	bool
	select CPU_FEROCEON
	select CLOCKSOURCE_ORION

#
# Armada 370 SoC boards
#

comment "Armada 370 based boards"

config MACH_GLOBALSCALE_MIRABOX
	bool "Globalscale Mirabox"
	select ARCH_ARMADA_370

config MACH_NETGEAR_RN104
	bool "Netgear ReadyNAS 104"
	select ARCH_ARMADA_370

#
# Armada XP SoC boards
#

comment "Armada XP based boards"

config MACH_LENOVO_IX4_300D
	bool "Lenovo Iomega ix4-300d"
	select ARCH_ARMADA_XP

config MACH_MARVELL_ARMADA_XP_DB
	bool "Marvell Armada XP DB"
	select ARCH_ARMADA_XP

config MACH_MARVELL_ARMADA_XP_GP
	bool "Marvell Armada XP GP"
	select ARCH_ARMADA_XP

config MACH_NETGEAR_RN2120
	bool "Netgear ReadyNAS 2120"
	select ARCH_ARMADA_XP

config MACH_PLATHOME_OPENBLOCKS_AX3
	bool "PlatHome OpenBlocks AX3"
	select ARCH_ARMADA_XP

#
# Armada 38x SoC boards
#

comment "Armada 38x based boards"

config MACH_TURRIS_OMNIA
	bool "Turris Omnia"
	select ARCH_ARMADA_38X

#
# Dove 88AP510 SoC boards
#

comment "Dove based boards"

config MACH_SOLIDRUN_CUBOX
	bool "SolidRun CuBox"
	select ARCH_DOVE

#
# Kirkwood SoC boards
#

comment "Kirkwood based boards"

config MACH_GLOBALSCALE_GURUPLUG
	bool "Guruplug"
	select ARCH_KIRKWOOD

config MACH_IOMEGA_ICONNECT
	bool "Iomega iConnect"
	select ARCH_KIRKWOOD
	help
	  Say y here to build barebox for the Iomega iConnect wireless data
	  station (Kirkwood 88F6281, 256 MiB DDR2, 512 MiB NAND). The
	  resulting barebox-iomega-iconnect.img is booted by the BootROM from
	  NAND or via kwboot over UART, barebox-iomega-iconnect-2nd.img can
	  be started from RAM by U-Boot or a JTAG debugger.

config MACH_PLATHOME_OPENBLOCKS_A6
	bool "PlatHome OpenBlocks A6"
	select ARCH_KIRKWOOD

config MACH_SEAGATE_DOCKSTAR
	bool "Seagate FreeAgent DockStar"
	select ARCH_KIRKWOOD
	help
	  Say y here to build barebox for the Seagate FreeAgent DockStar
	  (Kirkwood 88F6281, 128 MiB DDR2, 256 MiB NAND). The resulting
	  barebox-seagate-dockstar.img is booted by the BootROM from NAND
	  or via kwboot over UART, barebox-seagate-dockstar-2nd.img can be
	  started from RAM by U-Boot or a JTAG debugger.

config MACH_USI_TOPKICK
	bool "Topkick"
	select ARCH_KIRKWOOD

#
# Common options
#

config MVEBU_CONSOLE_UART
	int "UART number for console"
	default 0
	range 0 1 if ARCH_ARMADA_370
	range 0 1 if ARCH_ARMADA_XP
	range 0 3 if ARCH_DOVE
	range 0 1 if ARCH_KIRKWOOD
	help
	  Select the UART number the barebox console will sit on.

endif # ARCH_MVEBU
```
